## boards/shields/keyatura/Kconfig.defconfig
```kconfig
if SHIELD_KEYATURA_DONGLE

config ZMK_KEYBOARD_NAME
    default "Keyatura"

config ZMK_SPLIT_ROLE_CENTRAL
	default y
	
config ZMK_SPLIT_BLE_CENTRAL_PERIPHERALS
    default 2

endif

if SHIELD_KEYATURA_LEFT || SHIELD_KEYATURA_RIGHT || SHIELD_KEYATURA_DONGLE

config ZMK_SPLIT
    default y

endif
```

## boards/shields/keyatura/Kconfig.shield
```kconfig
config SHIELD_KEYATURA_LEFT
    def_bool $(shields_list_contains,keyatura_left)

config SHIELD_KEYATURA_RIGHT
    def_bool $(shields_list_contains,keyatura_right)

config SHIELD_KEYATURA_MOUSE
    def_bool $(shields_list_contains,keyatura_mouse)

config SHIELD_KEYATURA_DONGLE
    def_bool $(shields_list_contains,keyatura_dongle)
```

## config/west.yml
```yaml
manifest:
  remotes:
    - name: zmkfirmware
      url-base: https://github.com/zmkfirmware
    - name: caksoylar
      url-base: https://github.com/caksoylar
    - name: badjeff
      url-base: https://github.com/badjeff
  projects:
    - name: zmk
      remote: zmkfirmware
      revision: main
      import: app/west.yml
    - name: zmk-rgbled-widget
      remote: caksoylar
      revision: main
    - name: zmk-pmw3610-driver
      remote: badjeff
      revision: main
  self:
    path: config
```
