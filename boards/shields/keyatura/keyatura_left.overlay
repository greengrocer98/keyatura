#include "keyatura.dtsi"
#include "keyatura_esb_addr.dtsi"

&kscan0 {
    col-gpios
        = <&gpio0 29 GPIO_ACTIVE_HIGH>
        , <&gpio0 2 GPIO_ACTIVE_HIGH>
        , <&gpio1 15 GPIO_ACTIVE_HIGH>
        , <&gpio1 13 GPIO_ACTIVE_HIGH>
        , <&gpio1 11 GPIO_ACTIVE_HIGH>
        ;
};

&mouse_split {
    status = "disabled";
};