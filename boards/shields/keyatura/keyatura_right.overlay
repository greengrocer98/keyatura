#include "keyatura.dtsi"
#include "keyatura_esb_addr.dtsi"

&kscan0 {
	col-gpios
		= <&gpio0 17 GPIO_ACTIVE_HIGH>
		, <&gpio1 13 GPIO_ACTIVE_HIGH>
		, <&gpio1 15 GPIO_ACTIVE_HIGH>
		, <&gpio0 22 GPIO_ACTIVE_HIGH>
		, <&gpio0 29 GPIO_ACTIVE_HIGH>
		;
};

&default_transform {
	col-offset = <5>;
};

&mouse_split {
    status = "disabled";
};
